#include "oled.h"
#include "i2c.h"
#include "string.h"


/* 当前OLED的I2C地址（8位写地址） */
static uint8_t oled_addr = OLED_ADDR;
/* 脏页标记，1=需刷新，旧版按页刷新回退时使用 */
uint8_t dirty_page[8] = {1,1,1,1,1,1,1,1};

/* 8x16 ASCII字库（32-126共95个字符），每字符16字节，列优先存储 */
static const uint8_t font8x16[95][16] = {
    {0x00,0x00,0x00,0x00,0x00,0x00,0x00,0x00,0x00,0x00,0x00,0x00,0x00,0x00,0x00,0x00},/* 32 SP */
    {0x00,0x00,0x00,0xF8,0x00,0x00,0x00,0x00,0x00,0x00,0x00,0x33,0x30,0x00,0x00,0x00},/* 33 ! */
    {0x00,0x10,0x0C,0x06,0x10,0x0C,0x06,0x00,0x00,0x00,0x00,0x00,0x00,0x00,0x00,0x00},/* 34 " */
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    {0x00,0x06,0x01,0x01,0x02,0x02,0x04,0x04,0x00,0x00,0x00,0x00,0x00,0x00,0x00,0x00},/* 126 ~ */
};

/* 帧缓冲区：128列×8页，列优先，CPU修改后需调用OLED_Refresh同步到GDDRAM */
uint8_t oled_buf[128][8];

/* 标记指定页为脏页（需刷新），供旧版按页刷新回退使用 */
static void mark_dirty(uint8_t page)
{
    if (page < 8) dirty_page[page] = 1;
}

/* I2C写操作：单次发送，ACK超时100ms
 * 注意: 不要在失败时 DeInit/ReInit I2C，会导致 OLED 内部页指针错位花屏
 * 失败时返回错误，由 OLED_Refresh 保留脏标记，下次刷新自然恢复 */
static HAL_StatusTypeDef oled_i2c_write(uint8_t *data, uint16_t len)
{
    return HAL_I2C_Master_Transmit(&hi2c1, oled_addr, data, len, 100);
}

/* 发送单字节命令（前缀0x00） */
static void oled_write_cmd(uint8_t cmd)
{
    uint8_t data[2] = {0x00, cmd};
    oled_i2c_write(data, 2);
}

/* 返回当前使用的OLED I2C地址 */
uint8_t OLED_GetAddr(void)
{
    return oled_addr;
}

/* OLED初始化：SSD1309解锁→初始化序列→清缓冲区→开显示 */
void OLED_Init(void)
{
    HAL_Delay(200);
    oled_addr = 0x78;

    /* SSD1309命令锁解锁 */
    oled_write_cmd(0xFD);
    oled_write_cmd(0x12);

    uint8_t cmds[] = {
        0xAE,       /* 关闭显示 */
        0xD5, 0xA0, /* 时钟分频=1, 振荡频率=默认 */
        0xA8, 0x3F, /* 多路复用 1/64 */
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        0x20, 0x02, /* 页寻址模式 */
    };
    for (uint16_t i = 0; i < sizeof(cmds); i++) {
        oled_write_cmd(cmds[i]);
    }

    OLED_Clear();
    OLED_Refresh();        /* 开显示前先写零到GDDRAM */
    oled_write_cmd(0xAF); /* 开启显示 */
}

/* 清空帧缓冲区并标记全部脏页。不自动刷新——由调用者绘制完成后统一调用OLED_Refresh，避免闪烁 */
void OLED_Clear(void)
{
    memset(oled_buf, 0x00, sizeof(oled_buf));
    for (int i = 0; i < OLED_PAGES; i++) dirty_page[i] = 1;
}

/* 显示8x16字体字符串（占2页高），y需8对齐 */
void OLED_ShowString(uint8_t x, uint8_t y, const char *str)
{
    /* y需8对齐（8x16字体占2页） */
    uint8_t page = y / 8;
    if (page + 1 >= 8) return;

    while (*str)
    {
        uint8_t c = (uint8_t)*str;
        if (c < 32 || c > 126) c = 32;
        c -= 32;
        for (uint8_t col = 0; col < 8 && x + col < 128; col++)
        {
            oled_buf[x + col][page]     = font8x16[c][col];
            oled_buf[x + col][page + 1] = font8x16[c][col + 8];
        }
        x += 8; if (x >= 128) break;
        str++;
    }
    mark_dirty(page);
    mark_dirty(page + 1);
}

/* 显示单页8px高字符串（仅使用8x16字体上半部分） */
void OLED_ShowString8(uint8_t x, uint8_t y, const char *str)
{
    uint8_t page = y / 8;
    if (page >= 8) return;

    while (*str)
    {
        uint8_t c = (uint8_t)*str;
        if (c < 32 || c > 126) c = 32;
        c -= 32;
        for (uint8_t col = 0; col < 8 && x + col < 128; col++)
            oled_buf[x + col][page] = font8x16[c][col];
        x += 8; if (x >= 128) break;
        str++;
    }
    mark_dirty(page);
}

/* 显示有符号整数（8x16字体），支持负号显示 */
void OLED_ShowNum(uint8_t x, uint8_t y, int32_t num, uint8_t len)
{
    char buf[12];
    uint8_t neg = 0;
    if (num < 0) { neg = 1; num = -num; }
    uint8_t i = 0;
    do { buf[i++] = '0' + (num % 10); num /= 10; } while (num > 0 && i < 10);
    uint8_t total = (neg ? i + 1 : i);
    if (total < len) total = len;
    for (uint8_t j = 0; j < total; j++)
    {
        char ch;
        if (neg && total - j == i + 1) { ch = '-'; }
        else if (total - j > i)        { ch = ' '; }
        else                           { ch = buf[total - j - 1]; }
        char s[2] = {ch, 0};
        OLED_ShowString(x + j * 8, y, s);
    }
}

/* 显示浮点数（8x16字体），指定整数和小数位数 */
void OLED_ShowFloat(uint8_t x, uint8_t y, float num, uint8_t int_len, uint8_t dec_len)
{
    OLED_ShowNum(x, y, (int32_t)num, int_len);
    x += 8 * (int_len > 0 ? int_len : 1);
    OLED_ShowString(x, y, ".");
    x += 8;
    float frac = num - (float)((int32_t)num);
    if (frac < 0) frac = -frac;
    for (uint8_t i = 0; i < dec_len; i++) frac *= 10;
    OLED_ShowNum(x, y, (int32_t)(frac + 0.5f), dec_len);
}

/* 显示有符号整数（单页8px高），调试用 */
void OLED_ShowNum8(uint8_t x, uint8_t y, int32_t num, uint8_t len)
{
    char buf[12];
    uint8_t neg = 0;
    if (num < 0) { neg = 1; num = -num; }
    uint8_t i = 0;
    do { buf[i++] = '0' + (num % 10); num /= 10; } while (num > 0 && i < 10);
    uint8_t total = (neg ? i + 1 : i);
    if (total < len) total = len;
    for (uint8_t j = 0; j < total; j++)
    {
        char ch;
        if (neg && total - j == i + 1) { ch = '-'; }
        else if (total - j > i)        { ch = ' '; }
        else                           { ch = buf[total - j - 1]; }
        char s[2] = {ch, 0};
        OLED_ShowString8(x + j * 8, y, s);
    }
}

/* 显示浮点数（单页8px高），调试用 */
void OLED_ShowFloat8(uint8_t x, uint8_t y, float num, uint8_t int_len, uint8_t dec_len)
{
    OLED_ShowNum8(x, y, (int32_t)num, int_len);
    x += 8 * (int_len > 0 ? int_len : 1);
    OLED_ShowString8(x, y, ".");
    x += 8;
    float frac = num - (float)((int32_t)num);
    if (frac < 0) frac = -frac;
    for (uint8_t i = 0; i < dec_len; i++) frac *= 10;
    OLED_ShowNum8(x, y, (int32_t)(frac + 0.5f), dec_len);
}

/* 像素级画点：对帧缓冲区(x,y)位置写1或0，自动转换页/位并标记脏页 */
void OLED_DrawPixel(uint8_t x, uint8_t y, uint8_t color)
{
    if (x >= 128 || y >= 64) return;
    uint8_t page = y / 8;
    uint8_t bit  = y % 8;
    if (color)
        oled_buf[x][page] |=  (1 << bit);
    else
        oled_buf[x][page] &= ~(1 << bit);
    mark_dirty(page);
}

/* 页寻址脏页刷新：仅发送标记页，逐字节事务，I2C流量与脏页数成正比 */
void OLED_Refresh(void)
{
    for (uint8_t page = 0; page < 8; page++)
    {
        if (!dirty_page[page]) continue;

        oled_write_cmd(0xB0 | page);
        oled_write_cmd(0x00);
        oled_write_cmd(0x10);

        for (uint8_t col = 0; col < 128; col++) {
            uint8_t tmp[2] = {0x40, oled_buf[col][page]};
            oled_i2c_write(tmp, 2);
        }

        dirty_page[page] = 0;
    }
}
